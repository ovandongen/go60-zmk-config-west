## config/west.yml
```yaml
manifest:
  remotes:
    - name: moergo-sc
      url-base: https://github.com/moergo-sc
    - name: zzeneg
      url-base: https://github.com/zzeneg
    - name: ovandongen
      url-base: https://github.com/ovandongen
  projects:
    - name: zmk
      remote: moergo-sc
      revision: main
      import: app/west.yml
    - name: zmk-raw-hid
      remote: ovandongen
      revision: main
    - name: zmk-hid-viz
      remote: ovandongen
      revision: main
  self:
    path: config
```
